## drivers/Kconfig
```kconfig
append_menu "Device Drivers"

if ARCH_TEGRA
source "drivers/gpio-host-proxy/Kconfig"
source "drivers/gpio-guest-proxy/Kconfig"
endif

endmenu
```

## drivers/gpio-guest-proxy/Kconfig
```kconfig
config TEGRA_GPIO_GUEST_PROXY
	#depends on GPIO_TEGRA GPIO_TEGRA186
	bool "Tegra GPIO guest proxy driver"
	help
	The Tegra GPIO guest proxy driver, virtualise GPIO __iomem initalised by host, 
	allowing the guest to access host GPIO.

	Say Y here to enable this driver and to compile this driver as a module, 
	choose M here. If unsure, say N
```

## drivers/gpio-host-proxy/Kconfig
```kconfig
config TEGRA_GPIO_HOST_PROXY
	depends on GPIO_TEGRA && GPIO_TEGRA186
		bool "Tegra GPIO host proxy support"
		help
		Exposes the GPIO capabilities __iomem to the user space, in order to support the 
		GPIO passthrough to virtual machines.

		Say Y here to enable this driver and to compile this driver as a module, 
		choose M here. If unsure, say N
```
